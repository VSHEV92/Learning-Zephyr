## CMakeLists.txt
```
cmake_minimum_required(VERSION 3.20.0)
find_package(Zephyr REQUIRED HINTS $ENV{ZEPHYR_BASE})
project(bluetooth_shell)

target_sources(app PRIVATE src/main.c)
```

## prj.conf
```kconfig
CONFIG_SYSTEM_WORKQUEUE_STACK_SIZE=2048

CONFIG_BT=y
CONFIG_BT_SHELL=y
CONFIG_BT_CENTRAL=y
CONFIG_BT_DEVICE_NAME="esp32c3 shell"
CONFIG_BT_DEVICE_APPEARANCE=200

CONFIG_BT_SETTINGS=n

CONFIG_BT_GATT_CLIENT=y

CONFIG_SHELL_BACKEND_DUMMY=y
```

## src/main.c
```c
#include <string.h>

#include <zephyr/kernel.h>
#include <zephyr/shell/shell.h>
#include <zephyr/shell/shell_dummy.h>

#define HSL_FULL_PERIOD_MS 5000

char cmd[100];

int main() {

    const struct shell *sh = shell_backend_dummy_get_ptr();
    
    printk("Bluetooth shell example\n");

    shell_execute_cmd(sh, "bt init");
    shell_execute_cmd(sh, "bt connect-name \"Esp32 Led Strip\"");

    uint32_t hue = 0;
    int temp, hundreds, decimals, ones;

    while(true) {
        k_msleep( (int)(HSL_FULL_PERIOD_MS / 360) );

        // convert integer to hex symbols
        temp = hue;

        hundreds = temp / 100 + '0';
        temp %= 100;

        decimals = temp / 10 + '0';
        temp %= 10;

        ones = temp + '0';

        // write to attribute
        sprintf(cmd, "gatt write b 0 %02x%02x%02x", hundreds, decimals, ones);
        shell_execute_cmd(sh, cmd);
        
        // increment hue
        hue++;
        if (hue == 360) hue = 0;
    }
    
    return 0;
}
```
