## prj.conf
```kconfig
CONFIG_ADC=y
CONFIG_ADC_SHELL=y

CONFIG_SHELL=y
CONFIG_SHELL_VT100_COLORS=n
```

## boards/esp32c3_devkitm.overlay
```dts
/ {
    zephyr,user {
        io-channels = <&adc0 0>; 
    };
};

&adc0 {
    status = "okay";
    #address-cells = <1>;
    #size-cells = <0>;

    channel@0 {
        reg = <0>;
        
        /*
           ESP32C3:
           ADC_GAIN_1   = 0 dB (0..750 mV)
           ADC_GAIN_4_5 = 2.5 dB (0..1050 mV)
           ADC_GAIN_1_2 = 6 dB (0..1300 mV)
           ADC_GAIN_1_4 = 11 dB (0..2500 mV) 
        */
        
        zephyr,gain = "ADC_GAIN_1_4"; 
        zephyr,reference = "ADC_REF_INTERNAL";
        zephyr,acquisition-time = <ADC_ACQ_TIME_DEFAULT>;
        zephyr,resolution = <12>;
    };
};
```

## src/main.c
```c
#include <zephyr/kernel.h>

int main(void) {

    printk("ADC Shell Example\n");

	return 0;
}
```
